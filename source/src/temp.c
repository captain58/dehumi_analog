#include "temp.h"

#define OUM_K(p1)           ((uint32_t)(p1 * 1000))
#define OUM_M(p1)           (OUM_K(p1) * 1000)
#define HC32_ADC_FULL       (4096)  // adc 满量程
#define HC32_VCC_FULL       (5000)  // 电压满量程

// #define TEMP_OUM            (OUM_K(3.9))  // 温度分压电阻
// #define HUM_OUM_R2             (OUM_K(11))   // 湿度分压电阻
// #define HUM_OUM_R3             (OUM_K(36))   // 湿度分压电阻

#define TEMP_OUM            (OUM_K(10))  // 温度分压电阻
#define HUM_OUM_R2             (OUM_M(1))   // 湿度分压电阻
#define HUM_OUM_R3             (OUM_K(39))   // 湿度分压电阻

#define NTCTEMP_5K3470
// #define NTCTEMP_10K3950
#ifdef NTCTEMP_10K3950
static const uint32_t g_szNtcTempValue[166] = {
345275,
322791,
301925,
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350,
341};
#endif
#ifdef NTCTEMP_5K3470
static const uint32_t g_szNtcTempValue[291] = {
1050573,
992804,
938572,
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238,
235};
#endif
 
static const float g_szHumValue[18][12] = {
    /*  0               5               10              15              20          25                  30              35              40              45              50              55   温度 */
    {1282.373322,	942.031174,	    678.1911114,	552.8089417,	460.289414,	    375.1822181,	278.325385,	    212.9337588,	165.3862667,	127.1066986,	98.05780488,	75.16218176},/* 10 湿度 */
    {1177.605974,	866.9618758,	622.3002852,	504.6612976,	416.8693835,	338.8441561,	252.3480772,	192.7524913,	150.3141966,	115.3453258,	89.12509381,	68.23386941},/* 15 */
    {1062.36189,    784.3856477,	560.8203763,	451.698889,	    369.1073499,	298.8722879,	223.7730387,	170.5530971,	133.7349195,	102.4078156,	79.29911164,	60.61272584},/* 20 */
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    {2.413076923,	2.085384615,	1.668461538,	1.35,           1.113846154,	0.997461538,	0.881076923,	0.774615385,	0.670938462,	0.590769231,	0.5106,         0.46344692},/* 95 */
};

static uint64_t g_szTempArr[18] = {0};

int16_t GetTempFromAdc(uint32_t uiTemp) {
    float fVer = 0;
    uint32_t uiOum;
    int index;
    int idot;
    int iTemp;

    fVer = (float)uiTemp * HC32_VCC_FULL / HC32_ADC_FULL;
    uiOum = (uint32_t)(HC32_VCC_FULL * TEMP_OUM / fVer) - TEMP_OUM;

    #ifdef NTCTEMP_5K3470
    uiOum *= 10;
    #endif

    for (index = 0; index < sizeof(g_szNtcTempValue); index++) {
        if (g_szNtcTempValue[index] <= uiOum)
            break;
    }

    if (index == 0) {
        return -4000;
    }

    idot = (uiOum - g_szNtcTempValue[index]) * 100 / (g_szNtcTempValue[index-1] - g_szNtcTempValue[index]);
    iTemp = (index - 40) * 100 - idot;
    return iTemp;
}

uint16_t GetHumFromAdc(int16_t iTemp, uint32_t uiHum) {
    int64_t uiM;       /* 中间系数 */
    uint64_t uiOum;     /* 阻值 */
    uint16_t uiHumRes;  /* 湿度（乘100） */
    uint16_t uiTempIndex = 0;
    uint16_t uiTempdot = 0;
    int i;

    /* adc值为0，返回0 */
    if (uiHum == 0) {
        Debug_Print(">>>GetHumFromAdc failed! uihum is 0\n");
        return 0;
    }

    /* 温度不在测试范围内，返回0 */
    if ((iTemp < 0) || (iTemp > 5500)) {
        Debug_Print(">>>GetHumFromAdc failed! iTemp err\n");
        return 0;
    }

    /* 构建该温度下的阻值表 */
    memset(g_szTempArr, 0, sizeof(g_szTempArr));
    uiTempIndex = iTemp / 500;
    uiTempdot = iTemp % 500;
    for (i = 0; i < 18; i++) {
        if (uiTempIndex >= 11) {
            g_szTempArr[i] = (uint64_t)(g_szHumValue[i][11] * 1000);
        } else {
            g_szTempArr[i] = (uint64_t)(g_szHumValue[i][uiTempIndex] * 1000) - (uint64_t)((g_szHumValue[i][uiTempIndex] - g_szHumValue[i][uiTempIndex+1]) * 1000) * uiTempdot / 500;
        }
        // Debug_Print(">>>GetHumFromAdc: g_szTempArr %d:%llu\n", i, g_szTempArr[i]);
    }

    uiM = (HC32_ADC_FULL * HUM_OUM_R3) / uiHum - HUM_OUM_R3;
    uiOum =  uiM * HUM_OUM_R2 / (HUM_OUM_R2 - uiM); 

    // Debug_Print(">>>GetHumFromAdc: uiOum value :%llu\n", uiOum);
    
    /* 根据新的温度表获取湿度 */
    for (i = 0; i < 18; i++) {
        if (g_szTempArr[i] > uiOum) {
            continue;
        }

        if (i == 0) {
            if (g_szTempArr[0] < uiOum) {
                Debug_Print(">>>GetHumFromAdc: g_szTempArr[0] value :%llu, uiOum value : %llu\n", g_szTempArr[0], uiOum);
                return 0;
            } else {
                return 1000;
            }
        }

        uiHumRes = 1000 + i * 500 - (uiOum - g_szTempArr[i]) * 500 / (g_szTempArr[i-1] - g_szTempArr[i]);
        return uiHumRes;
    }

    Debug_Print(">>>GetHumFromAdc: not find\n");
    return 0;
}

boolean_t Sync_TempHum(int16_t *pitemp, uint16_t *puiHum) {
    uint32_t uiTemp = 0;
    uint32_t uiHum = 0;
    uint32_t szTemp[5];
    uint32_t szHum[5];
    uint16_t i = 0;
    uint16_t j = 0;
    uint16_t uiHum_tmp = 0;

    while (1) {
        IoDevSetRH_IO1(1);
        IoDevSetRH_IO2(0);
        delay10us(45);
        uiHum += Bsp_Adc_GetAdc(BSP_ADC_HUMP_CHANAL);
        delay10us(2);
        IoDevSetRH_IO1(0);
        IoDevSetRH_IO2(1);
        delay10us(25);
        uiTemp += Bsp_Adc_GetAdc(BSP_ADC_TEMP_CHANAL);
        delay10us(21);
        i++;
        if (i >= 30) {
            szTemp[j] = uiTemp / 30;
            szHum[j] = uiHum / 30;
            j++;
            if (j >= 5) {
                IoDevSetRH_IO1(0);
                IoDevSetRH_IO2(0);
                uiTemp = (szTemp[1] + szTemp[2] + szTemp[3] + szTemp[4]) / 4;
                uiHum = (szHum[1] + szHum[2] + szHum[3] + szHum[4]) / 4;
                break;
            }
            i = 0;
            uiTemp = 0;
            uiHum = 0;
        }
    }
    
    Debug_Print(">>>Sync_TempHum: adc value temp:%u, humi:%u\n", uiTemp, uiHum);

    if (uiTemp == 0) {
        return FALSE;
    }

    

    *pitemp = GetTempFromAdc(uiTemp);

    if (*pitemp < -3900) {
        Debug_Print(">>>GetTempFromAdc failed! temp:%d\n", *pitemp);
        return FALSE;
    }

    
    uiHum_tmp = GetHumFromAdc(*pitemp, uiHum);
    if(0 != uiHum_tmp)
    {
        if(uiHum_tmp < 1500) 
        {
            
            Debug_Print(">>>Sync_TempHum: humi src %d correct to:2000\n", uiHum);
            uiHum_tmp = 1500;
        }
        *puiHum = uiHum_tmp;
    }
    else
    {
        Debug_Print(">>>Sync_TempHum: can't calculate , maintain old value \n");
    }
    
//	    if(uiHum >= 4096)
//	    {
//	        Debug_Print(">>>Sync_TempHum: humi src %d correct to:9500\n", uiHum);
//	        uiHum = 9500;
//	    }
//	    else
//	    {
//	        uiHum = GetHumFromAdc(*pitemp, uiHum);
//	        
//	        if(uiHum < 1500) 
//	        {
//	            
//	            Debug_Print(">>>Sync_TempHum: humi src %d correct to:2000\n", uiHum);
//	            uiHum = 1500;
//	        }
//	        
//	    }
//	    *puiHum  = uiHum;
    Debug_Print(">>>Sync_TempHum: temp:%d, humi:%u\n", *pitemp, *puiHum);
    return TRUE;
}

/*
while(1)
{
    CLRIO2();
    SETIO1();
    DelayXus(250);
    GETADCH += GetADCResult(CHRH);//湿度 ADC 值
    DelayXus(210);//减去大概的 AD 采样时间
    CLRIO1();
    SETIO2();
    DelayXus(250);
    GETADCT += GetADCResult(CHRT);//温度 ADC 采样
    DelayXus(210);
    if((++i)>=30)//一次采样 30 个周期
    {
        AvgTem[k] = GETADCT/30;
        AvgHum[k] = GETADCH/30;
        if((++k)>=5)
        {
            CLRIO2();//让 IO1 与 IO2 同时置为低电平，减小直流时间段
            CLRIO1();
            //由于开始一次采样误差较大，去掉 AvgTem[0]
            SumTem = AvgTem[1]+AvgTem[2]+AvgTem[3]+AvgTem[4];
            SumTem = SumTem/4;
            SumHum = AvgHum[1]+AvgHum[2]+AvgHum[3]+AvgHum[4];
            SumHum = SumHum/4;
            ResultTem = GetTemp(SumTem);//得到温度
            //通过函数查表得到对应湿度值
            //可以将阻值全部转化成对应 AD 值，通过快速查表，省去很大的内存空间
            ResultHu = Tansfom(SumHum,ResultTem);
            - 9 -
            *Hum = (uint)ResultHu;
            *tem = (int)ResultTem;
            break;//退出
        }
        GETADCH = 0;
        GETADCT = 0;
        i=0;
    }
}

*/
